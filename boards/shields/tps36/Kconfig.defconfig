## boards/shields/tps36/Kconfig.defconfig
```kconfig
# Copyright (c) 2022 ZMK Contributors
# SPDX-License-Identifier: MIT
 
if SHIELD_TPS36_RIGHT

config ZMK_KEYBOARD_NAME
	default "TPS36"

config ZMK_SPLIT_BLE_ROLE_CENTRAL
	default y

endif

# if SHIELD_TPS36_LEFT

# config ZMK_KEYBOARD_NAME
	# default "TPS36 Left"

# endif

if SHIELD_TPS36_LEFT || SHIELD_TPS36_RIGHT

config ZMK_SPLIT
	default y
	
endif
```

## boards/shields/tps36/Kconfig.shield
```kconfig
# Copyright (c) 2020 ZMK Contributors
# SPDX-License-Identifier: MIT

config SHIELD_TPS36_LEFT
	def_bool $(shields_list_contains,tps36_left)

config SHIELD_TPS36_RIGHT
	def_bool $(shields_list_contains,tps36_right)
```
